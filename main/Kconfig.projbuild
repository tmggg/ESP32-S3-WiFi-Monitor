## main/Kconfig.projbuild
```kconfig
menu "Wi-Fi provisioning"

config PROV_AP_SSID_PREFIX
    string "Provisioning AP SSID prefix"
    default "ESP32-S3"

config PROV_AP_PASSWORD
    string "Provisioning AP password (8-63 characters)"
    default "12345678"

config PROV_CONNECT_TIMEOUT_SECONDS
    int "Saved network connection timeout"
    range 5 120
    default 30

config PROV_BOOT_BUTTON_GPIO
    int "BOOT button GPIO"
    range 0 48
    default 0

config PROV_BOOT_BUTTON_HOLD_MS
    int "Hold time to erase Wi-Fi configuration (ms)"
    range 1000 10000
    default 3000

endmenu
```

## sdkconfig.defaults
```kconfig
CONFIG_IDF_TARGET="esp32s3"
CONFIG_SPIRAM=y
CONFIG_SPIRAM_MODE_OCT=y
CONFIG_SPIRAM_SPEED_80M=y
CONFIG_ESPTOOLPY_FLASHSIZE_16MB=y
CONFIG_PARTITION_TABLE_CUSTOM=y
CONFIG_PARTITION_TABLE_CUSTOM_FILENAME="partitions.csv"
CONFIG_ESP_WIFI_SOFTAP_SUPPORT=y
CONFIG_HTTPD_MAX_REQ_HDR_LEN=4096
CONFIG_HTTPD_MAX_URI_LEN=1024
CONFIG_HTTPD_PURGE_BUF_LEN=256
CONFIG_PROV_AP_PASSWORD="12345678"
CONFIG_LV_COLOR_DEPTH_16=y
# CONFIG_LV_COLOR_16_SWAP is not set
CONFIG_LV_DISP_DEF_REFR_PERIOD=16
CONFIG_LV_FONT_MONTSERRAT_12=y
CONFIG_LV_FONT_MONTSERRAT_14=y
CONFIG_LV_FONT_MONTSERRAT_18=y
```
